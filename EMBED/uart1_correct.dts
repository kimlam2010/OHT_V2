/dts-v1/;
/plugin/;

/ {
    compatible = "rockchip,rk3588s-orangepi-5b", "rockchip,rk3588";

    fragment@0 {
        target = <&uart1>;
        __overlay__ {
            status = "okay";
            pinctrl-names = "default";
            pinctrl-0 = <&uart1m1_xfer>;
        };
    };
};
