/dts-v1/;
/plugin/;

/ {
    compatible = "rockchip,rk3588";

    fragment@0 {
        target = <&uart1>;
        __overlay__ {
            status = "okay";
            pinctrl-names = "default";
            pinctrl-0 = <&uart1_46_47_xfer>;
        };
    };

    fragment@1 {
        target = <&pinctrl>;
        __overlay__ {
            uart1_46_47_xfer: uart1-46-47-xfer {
                rockchip,pins = 
                    <1 17 1 &pcfg_pull_up>,  /* GPIO1_D1 (Pin 46) - TX */
                    <1 16 1 &pcfg_pull_up>;  /* GPIO1_D0 (Pin 47) - RX */
            };
        };
    };
};
